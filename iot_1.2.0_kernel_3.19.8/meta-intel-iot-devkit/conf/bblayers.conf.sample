## iot_1.2.0_kernel_3.19.8/meta-intel-iot-devkit/conf/bblayers.conf.sample
```bitbake
# LAYER_CONF_VERSION is increased each time build/conf/bblayers.conf
# changes incompatibly
LCONF_VERSION = "6"

BBPATH = "${TOPDIR}"
BBFILES ?= ""

BBLAYERS ?= " \
  ##OEROOT##/meta \
  ##OEROOT##/meta-yocto \
  ##OEROOT##/meta-intel-iot-devkit \
  ##OEROOT##/meta-intel-iot-middleware \
  ##OEROOT##/meta-intel-quark \
  ##OEROOT##/meta-intel-galileo \
  ##OEROOT##/meta-netcontiki \
  ##OEROOT##/meta-openembedded/meta-networking \
  "
BBLAYERS_NON_REMOVABLE ?= " \
  ##OEROOT##/meta \
  ##OEROOT##/meta-yocto \
  "
```

## iot_1.2.0_kernel_3.19.8/meta-intel-iot-devkit/conf/distro/include/iot-devkit.inc
```bitbake
SANITY_TESTED_DISTROS = " \
            Ubuntu-14.04 \n \
            Fedora-20 \n \
            Debian-7.8 \n \
            openSUSE-project-13.1 \n \
            "

DISTRO_VERSION = "1.5"
DISTRO_CODENAME = "panda"
DISTRO_NAME = "iot-devkit (Intel IoT Development Kit)"
MAINTAINER = "Yocto Devkit <yocto-devkit@linux.intel.com>"

# Changing these currently breaks the Eclipse plugin
#TARGET_VENDOR = "-iotkit"
#SDK_VENDOR = "-iotkit"

SSTATE_DIR ?= "${TOPDIR}/../devkit-cache/sstate-cache"
CACHE_forcevariable = "${TOPDIR}/../devkit-cache/cache"
PERSISTENT_DIR = "${TOPDIR}/../devkit-cache/persistent"
```

## iot_1.2.0_kernel_3.19.8/meta-intel-iot-devkit/conf/distro/iot-devkit-multilibc.conf
```bitbake
require conf/distro/iot-devkit.conf
require conf/multilib.conf

MULTILIBS = "multilib:lib32"
DEFAULTTUNE_virtclass-multilib-lib32 = "x86"
baselib_virtclass-multilib-lib32 = "lib32"
LIBCEXTENSION_virtclass-multilib-lib32 = "-uclibc"
LIBCOVERRIDE_virtclass-multilib-lib32 = ":libc-uclibc"
PREFERRED_PROVIDER_virtual/lib32-libc ?= "uclibc"
PREFERRED_PROVIDER_virtual/lib32-libiconv ?= "libiconv"
PREFERRED_PROVIDER_virtual/lib32-libintl ?= "gettext"
USE_NLS_virtclass-multilib-lib32 ?= "no"
CXXFLAGS_append_virtclass-multilib-lib32 = " -fvisibility-inlines-hidden"
IMAGE_LINGUAS_virtclass-multilib-lib32 = ""
LIBC_DEPENDENCIES_virtclass-multilib-lib32 = "uclibc uclibc-dbg uclibc-dev uclibc-thread-db"
PTEST_ENABLED_virtclass-multilib-lib32 = ""
TOOLCHAIN_NEED_CONFIGSITE_CACHE = ""
EXCLUDE_FROM_WORLD_virtclass-multilib-lib32 = "1"
```

## iot_1.2.0_kernel_3.19.8/meta-intel-iot-devkit/conf/distro/iot-devkit-spi.conf
```bitbake
require conf/distro/poky-tiny.conf
require include/iot-devkit.inc

DISTRO = "iot-devkit-spi"

# poky-tiny forces linux-yocto-tiny otherwise
PREFERRED_PROVIDER_virtual/kernel = "linux-yocto-quark"
PREFERRED_VERSION_linux-yocto-quark = "3.19%"

VIRTUAL-RUNTIME_dev_manager = ""
VIRTUAL-RUNTIME_init_manager = "sysvinit"
VIRTUAL-RUNTIME_initscripts = "initscripts"

PACKAGE_CLASSES = "package_ipk"

INITRAMFS_TYPES = "cpio.gz cpio.lzma"

# check if these are still necessary - what are they needed for?
DISTRO_FEATURES_LIBC = "libc-posix-clang-wchar libc-posix-wchar-io"

DISTRO_FEATURES = "ipv4 ipv6 ppp xattr alsa argp ${DISTRO_FEATURES_LIBC} largefile"

DISTRO_FEATURES_append_class-nativesdk = " ${DISTRO_FEATURES_LIBC}"

TCLIBC = "uclibc"

# Can't build for spi in the same TMPDIR since the different libc
#  implementations don't play well together
TMPDIR .= "-spi"
```

## iot_1.2.0_kernel_3.19.8/meta-intel-iot-devkit/conf/distro/iot-devkit.conf
```bitbake
require conf/distro/poky.conf
require include/iot-devkit.inc

DISTRO = "iot-devkit"
DISTRO_FEATURES_append = " systemd"

PREFERRED_PROVIDER_virtual/kernel = "linux-yocto-quark"
PREFERRED_VERSION_linux-yocto-quark = "3.19%"
#PREFERRED_VERSION_grub = "0.97%"

PREFERRED_PROVIDER_jpeg = "libjpeg-turbo"
PREFERRED_PROVIDER_jpeg-native = "libjpeg-turbo-native"

# change these to something better
IMAGE_FSTYPES = "cpio.gz cpio.lzma"

PACKAGE_CLASSES = "package_ipk"

VIRTUAL-RUNTIME_dev_manager = "udev"
VIRTUAL-RUNTIME_init_manager = "systemd"
VIRTUAL-RUNTIME_initscripts = ""

DISTRO_FEATURES_BACKFILL_CONSIDERED = "sysvinit"
```

## iot_1.2.0_kernel_3.19.8/meta-intel-quark/conf/machine/quark.conf
```bitbake
#@TYPE: Machine
#@NAME: quark

#@DESCRIPTION: Machine configuration for Quark systems

PREFERRED_PROVIDER_virtual/kernel ?= "linux-yocto-quark"
PREFERRED_VERSION_linux-yocto-quark ?= "3.19%"

require conf/machine/include/x86-base.inc
include conf/machine/include/tune-i586.inc

#Avoid pulling in GRUB
MACHINE_ESSENTIAL_EXTRA_RDEPENDS = ""

MACHINE_FEATURES = "efi usb pci"

SERIAL_CONSOLE = "115200 ttyS1"
#SERIAL_CONSOLES = "115200;ttyS0 115200;ttyS1"

EXTRA_IMAGEDEPENDS = "grub"
PREFERRED_VERSION_grub = "0.97+git%"

TUNE_CCARGS += "-Wa,--momit-lock-prefix=yes"
```
